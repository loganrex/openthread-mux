## drivers/entropy/Kconfig.qemu
```kconfig
menuconfig FAKE_ENTROPY_QEMU
	bool "qemu entropy driver"
	default y
	depends on DT_HAS_ZEPHYR_QEMU_RNG_ENABLED
	select ENTROPY_HAS_DRIVER
```

## drivers/ieee802154/Kconfig
```kconfig
# IEEE 802.15.4 driver configuration options

# Copyright (c) 2015 Intel Corporation
# SPDX-License-Identifier: Apache-2.0

#
# IEEE 802.15.4 options
#
menuconfig IEEE802154_ETC
	bool "IEEE 802.15.4 drivers"
	depends on NETWORKING
	default y if NET_L2_PHY_IEEE802154

if IEEE802154_ETC

rsource "Kconfig.etc_uart_pipe"

endif # IEEE802154_ETC
```

## drivers/ieee802154/Kconfig.etc_uart_pipe
```kconfig
config IEEE802154_ETC_UPIPE
	bool "UART PIPE fake radio driver support for QEMU"
	default y
	depends on (BOARD_NATIVE_SIM_64 || BOARD_NATIVE_SIM ) && \
		   DT_HAS_ETC_IEEE802154_UART_PIPE_ENABLED
	select UART_PIPE

if IEEE802154_ETC_UPIPE

config IEEE802154_ETC_UPIPE_HW_FILTER
	bool "Hw Filtering"
	default y
	help
	  This option assure the driver will process just frames addressed to him.

config IEEE802154_ETC_UPIPE_RANDOM_MAC
	bool "Random MAC address"
	default y
	help
	  Generate a random MAC address dynamically.

config IEEE802154_ETC_UPIPE_MAC4
	hex "MAC Address Byte 4"
	default 0x40
	range 0 0xff
	help
	  This is the byte 4 of the MAC address.

config IEEE802154_ETC_UPIPE_MAC5
	hex "MAC Address Byte 5"
	default 0x50
	range 0 0xff
	help
	  This is the byte 5 of the MAC address.

config IEEE802154_ETC_UPIPE_MAC6
	hex "MAC Address Byte 6"
	default 0x60
	range 0 0xff
	help
	  This is the byte 6 of the MAC address.

config IEEE802154_ETC_UPIPE_MAC7
	hex "MAC Address Byte 7"
	default 0x70
	range 0 0xff
	help
	  This is the byte 7 of the MAC address.

endif # IEEE802154_ETC_UPIPE
```

## drivers/serial/Kconfig.named_pipe
```kconfig
# Copyright (c) 2023 Marko Sagadin
# SPDX-License-Identifier: Apache-2.0


config ETC_UART_NAMED_PIPE_0
	bool "UART driver for interacting with named pipes"
	default y
	depends on DT_HAS_ETC_UART_NAMED_PIPE_0_ENABLED
	select SERIAL_HAS_DRIVER
	select SERIAL_SUPPORT_INTERRUPT
	select UART_INTERRUPT_DRIVEN
```

## drivers/serial/Kconfig.native_tcp
```kconfig
# Copyright (c) 2023 Marko Sagadin
# SPDX-License-Identifier: Apache-2.0
config ETC_UART_NATIVE_TCP
	bool "UART driver for interacting with host serial ports"
	default y
	depends on DT_HAS_ETC_NATIVE_TCP_UART_ENABLED
	select SERIAL_HAS_DRIVER
	select SERIAL_SUPPORT_INTERRUPT
	select UART_INTERRUPT_DRIVEN

config ETC_UART_NATIVE_TCP_0
	bool "UART driver for interacting with host serial ports"
	default y
	depends on DT_HAS_ETC_NATIVE_TCP_UART_0_ENABLED
	select SERIAL_HAS_DRIVER
	select SERIAL_SUPPORT_INTERRUPT
	select UART_INTERRUPT_DRIVEN

config ETC_UART_NATIVE_TCP_1
	bool "UART driver for interacting with host serial ports"
	default y
	depends on DT_HAS_ETC_NATIVE_TCP_UART_1_ENABLED
	select SERIAL_HAS_DRIVER
	select SERIAL_SUPPORT_INTERRUPT
	select UART_INTERRUPT_DRIVEN

config ETC_UART_NATIVE_TCP_2
	bool "UART driver for interacting with host serial ports"
	default y
	depends on DT_HAS_ETC_NATIVE_TCP_UART_2_ENABLED
	select SERIAL_HAS_DRIVER
	select SERIAL_SUPPORT_INTERRUPT
	select UART_INTERRUPT_DRIVEN
```

## drivers/serial/Kconfig.native_tty
```kconfig
# Copyright (c) 2023 Marko Sagadin
# SPDX-License-Identifier: Apache-2.0
config ETC_UART_NATIVE_TTY
	bool "UART driver for interacting with host serial ports"
	default y
	depends on DT_HAS_ETC_NATIVE_TTY_UART_ENABLED
	select SERIAL_HAS_DRIVER
	select SERIAL_SUPPORT_INTERRUPT
	select UART_INTERRUPT_DRIVEN
```

## dts/bindings/ieee802154/etc,ieee802154-uart-pipe.yaml
```yaml
description: UART PIPE fake radio device (used in QEMU)

compatible: "etc,ieee802154-uart-pipe"

include: base.yaml
```

## dts/bindings/ieee802154/nordic,nrfx-ieee802154.yaml
```yaml
description: Nordic nRF IEEE 802.15.4 node simulator

compatible: "nordic,nrfx-ieee802154"

include: base.yaml
```

## dts/bindings/serial/etc,native-tcp-uart-0.yaml
```yaml
description: Native TCP UART

include: uart-controller.yaml

compatible: "etc,native-tcp-uart-0"
bus: uart

properties:
  tcp-host:
    type: string
    description: |
      Host to connect to via TCP
  tcp-port:
    type: int
    description: |
      TCP port
```

## dts/bindings/serial/etc,native-tcp-uart-1.yaml
```yaml
description: Native TCP UART

include: uart-controller.yaml

compatible: "etc,native-tcp-uart-1"
bus: uart

properties:
  tcp-host:
    type: string
    description: |
      Host to connect to via TCP
  tcp-port:
    type: int
    description: |
      TCP port
  is-server:
    type: boolean 
    description: |
      TCP server
```

## dts/bindings/serial/etc,uart-named-pipe-0.yaml
```yaml
description: Native TCP UART

include: uart-controller.yaml

compatible: "etc,uart-named-pipe-0"
bus: uart

properties:
  rx-pipe:
    type: string
    description: |
      Path to rx-pipe
  tx-pipe:
    type: string
    description: |
      Path to tx-pipe
```

## west.yml
```yaml
manifest:
  defaults:
    remote: upstream

  remotes:
    - name: upstream
      url-base: https://github.com/zephyrproject-rtos
    - name: openthreadsim
      url-base: https://github.com/loganrex

  projects:
    - name: openthread-sim-drivers
      remote: openthreadsim
      revision: main
      path: modules/openthread-sim-drivers
  
  self:
    path: zephyr
    west-commands: scripts/west-commands.yml
    import: submanifests
```
